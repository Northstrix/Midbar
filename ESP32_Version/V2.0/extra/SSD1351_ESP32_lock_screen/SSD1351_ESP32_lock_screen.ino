/*
Midbar
Distributed under the MIT License
© Copyright Maxim Bortnikov 2022
For more information please visit
https://sourceforge.net/projects/midbar/
https://osdn.net/projects/midbar/
https://github.com/Northstrix/Midbar
Required libraries:
https://github.com/zhouyangchao/AES
https://github.com/peterferrie/serpent
https://github.com/ddokkaebi/Blowfish
https://github.com/Northstrix/DES_and_3DES_Library_for_MCUs
https://github.com/ulwanski/sha512
https://github.com/adafruit/Adafruit-GFX-Library
https://github.com/adafruit/Adafruit-SSD1351-library
https://github.com/adafruit/Adafruit_BusIO
https://github.com/GyverLibs/GyverBus
https://github.com/PaulStoffregen/PS2Keyboard
https://github.com/siara-cc/esp32_arduino_sqlite3_lib
https://github.com/intrbiz/arduino-crypto
https://github.com/GyverLibs/EncButton
https://github.com/Chris--A/Keypad
https://github.com/platisd/nokia-5110-lcd-library
*/
/*************************************************** 
  This is a example sketch demonstrating graphic drawing
  capabilities of the SSD1351 library for the 1.5" 
  and 1.27" 16-bit Color OLEDs with SSD1351 driver chip
  Pick one up today in the adafruit shop!
  ------> http://www.adafruit.com/products/1431
  ------> http://www.adafruit.com/products/1673
 
  If you're using a 1.27" OLED, change SCREEN_HEIGHT to 96 instead of 128.
  These displays use SPI to communicate, 4 or 5 pins are required to  
  interface
  Adafruit invests time and resources providing this open source code, 
  please support Adafruit and open-source hardware by purchasing 
  products from Adafruit!
  Written by Limor Fried/Ladyada for Adafruit Industries.  
  BSD license, all text above must be included in any redistribution
  The Adafruit GFX Graphics core library is also required
  https://github.com/adafruit/Adafruit-GFX-Library
  Be sure to install it!
 ****************************************************/

// Screen dimensions
#define SCREEN_WIDTH  128
#define SCREEN_HEIGHT 128 // Change this to 96 for 1.27" OLED.

// You can use any (4 or) 5 pins 
// ESP32

#define SCLK_PIN 18
#define MOSI_PIN 23
#define DC_PIN   2
#define CS_PIN   15
#define RST_PIN  4

// ESP8266
/*
#define SCLK_PIN D5
#define MOSI_PIN D7
#define DC_PIN   D4
#define CS_PIN   D8
#define RST_PIN  D6
*/

#include <Adafruit_GFX.h>
#include <Adafruit_SSD1351.h>
#include <SPI.h>

// Option 1: use any pins but a little slower
//Adafruit_SSD1351 tft = Adafruit_SSD1351(SCREEN_WIDTH, SCREEN_HEIGHT, CS_PIN, DC_PIN, MOSI_PIN, SCLK_PIN, RST_PIN);  

// Option 2: must use the hardware SPI pins 
// (for UNO thats sclk = 13 and sid = 11) and pin 10 must be 
// an output. This is much faster - also required if you want
// to use the microSD card (see the image drawing example)
Adafruit_SSD1351 oled = Adafruit_SSD1351(SCREEN_WIDTH, SCREEN_HEIGHT, &SPI, CS_PIN, DC_PIN, RST_PIN);

const uint16_t conv_to_565_img [128][129] = {
{0,0,0,0,0,0,0,0,0,0,0,0,0,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6208,0},
{0,0,0,0,0,0,0,0,0,0,0,0,0,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6240,0},
{0,0,0,0,0,0,0,0,0,0,0,0,0,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4128,0},
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{0,0,0,0,0,0,0,0,0,0,0,0,0,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0,0}
};

const bool midbar_icon PROGMEM [70][18] = {
{true,true,true,false,false,false,false,false,false,false,false,false,false,false,false,false,false,false},
{true,true,true,false,false,false,false,false,false,false,false,false,false,false,false,false,false,false},
{true,true,true,false,false,false,false,false,false,false,false,false,false,false,false,false,false,false},
{true,true,true,false,false,false,false,false,false,false,false,false,false,false,false,false,false,false},
{true,true,true,false,false,false,false,false,false,false,false,false,false,false,false,false,false,false},
{true,true,true,false,false,false,false,false,false,false,false,false,false,false,false,false,false,false},
{true,true,true,false,false,false,false,false,false,false,false,false,false,false,false,false,false,false},
{true,true,true,false,false,false,false,false,false,false,false,false,false,false,false,false,false,false},
{true,true,true,false,false,false,false,false,false,false,false,false,false,false,false,false,false,false},
{true,true,true,false,false,false,false,false,false,false,false,false,false,false,false,false,false,false},
{true,true,true,true,false,false,false,false,false,false,false,false,false,false,false,false,false,false},
{true,true,true,true,true,false,false,false,false,false,false,false,false,false,false,false,false,false},
{false,true,true,true,true,true,true,true,true,true,true,true,true,true,true,true,true,true},
{false,false,true,true,true,true,true,true,true,true,true,true,true,true,true,true,true,true},
{false,false,false,true,true,true,true,true,true,true,true,true,true,true,true,true,true,true},
{false,false,false,false,false,false,false,false,false,false,false,false,false,false,false,false,false,false},
{false,false,false,false,false,false,false,false,false,false,false,false,false,false,false,false,false,false},
{true,true,true,false,false,false,false,false,false,false,false,false,false,false,false,true,true,true},
{true,true,true,false,false,false,false,false,false,false,false,false,false,false,false,true,true,true},
{true,true,true,false,false,false,false,false,false,false,false,false,false,false,false,true,true,true},
{true,true,true,false,false,false,false,false,false,false,false,false,false,false,false,true,true,true},
{true,true,true,false,false,false,false,false,false,false,false,false,false,false,false,true,true,true},
{true,true,true,false,false,false,false,false,false,false,false,false,false,false,false,true,true,true},
{true,true,true,false,false,false,false,false,false,false,false,false,false,false,false,true,true,true},
{true,true,true,false,false,false,false,false,false,false,false,false,false,false,false,true,true,true},
{true,true,true,false,false,false,false,false,false,false,false,false,false,false,false,true,true,true},
{true,true,true,true,false,false,false,false,false,false,false,false,false,false,false,true,true,true},
{true,true,true,true,true,false,false,false,false,false,false,false,false,false,false,true,true,true},
{false,true,true,true,true,true,true,true,true,true,true,true,true,true,true,true,true,true},
{false,false,true,true,true,true,true,true,true,true,true,true,true,true,true,true,true,true},
{false,false,false,true,true,true,true,true,true,true,true,true,true,true,true,true,true,true},
{false,false,false,false,false,false,false,false,false,false,false,false,false,false,false,true,true,true},
{false,false,false,false,false,false,false,false,false,false,false,false,false,false,false,true,true,true},
{false,false,false,false,false,false,false,false,false,false,false,false,false,false,false,true,true,true},
{false,false,false,false,false,false,false,false,false,false,false,false,false,false,false,false,false,false},
{true,true,true,false,false,false,false,false,false,false,false,false,false,false,false,false,false,false},
{true,true,true,false,false,false,false,false,false,false,false,false,false,false,false,false,false,false},
{true,true,true,false,false,false,false,false,false,false,false,false,false,false,false,false,false,false},
{true,true,true,false,false,false,false,false,false,false,false,false,false,false,false,false,false,false},
{true,true,true,false,false,false,false,false,false,false,false,false,false,false,false,false,false,false},
{true,true,true,false,false,false,false,false,false,false,false,false,false,false,false,false,false,false},
{true,true,true,false,false,false,false,false,false,false,false,false,false,false,false,false,false,false},
{true,true,true,false,false,false,false,false,false,false,false,false,false,false,false,false,false,false},
{true,true,true,false,false,false,false,false,false,false,false,false,false,false,false,false,false,false},
{true,true,true,false,false,false,false,false,false,false,false,false,false,false,false,false,false,false},
{true,true,true,true,true,true,true,true,true,true,true,true,true,true,true,true,true,true},
{true,true,true,true,true,true,true,true,true,true,true,true,true,true,true,true,true,true},
{true,true,true,true,true,true,true,true,true,true,true,true,true,true,true,true,true,true},
{true,true,true,false,false,false,false,false,false,false,false,false,false,false,false,false,false,false},
{true,true,true,false,false,false,false,false,false,false,false,false,false,false,false,false,false,false},
{true,true,true,false,false,false,false,false,false,false,false,false,false,false,false,false,false,false},
{false,false,false,false,false,false,false,false,false,false,false,false,false,false,false,false,false,false},
{false,false,false,false,false,false,false,false,false,false,false,false,false,false,false,false,false,false},
{true,true,false,false,false,false,false,false,false,false,false,false,false,false,false,false,true,true},
{true,true,true,true,true,false,false,false,false,false,false,false,true,true,true,true,true,true},
{true,true,true,true,true,true,true,false,true,true,true,true,true,true,true,true,true,true},
{false,false,true,true,true,true,true,true,true,true,true,true,true,true,true,true,false,false},
{false,false,false,false,true,true,true,true,true,true,true,true,false,false,false,false,false,false},
{false,false,true,true,true,true,true,true,false,false,false,false,false,false,false,false,false,false},
{false,true,true,true,true,true,false,false,false,false,false,false,false,false,false,false,false,false},
{false,true,true,true,false,false,false,false,false,false,false,false,false,false,false,true,true,true},
{true,true,true,true,false,false,false,false,false,false,false,false,false,false,false,true,true,true},
{true,true,true,false,false,false,false,false,false,false,false,false,false,false,false,true,true,true},
{true,true,true,false,false,false,false,false,false,false,false,false,false,false,false,true,true,true},
{true,true,true,false,false,false,false,false,false,false,false,false,false,false,false,true,true,true},
{true,true,true,true,false,false,false,false,false,false,false,false,false,false,false,true,true,true},
{true,true,true,true,true,false,false,false,false,false,false,false,false,false,false,true,true,true},
{false,true,true,true,true,true,true,true,true,true,true,true,true,true,true,true,true,true},
{false,false,true,true,true,true,true,true,true,true,true,true,true,true,true,true,true,true},
{false,false,false,true,true,true,true,true,true,true,true,true,true,true,true,true,true,true}
};

void setup(void) {
  oled.begin();
  for (int i = 0; i < 128; i++) {
    for (int j = 0; j < 128; j++) {
      oled.drawPixel(i, j, conv_to_565_img[i][j]);
    }
  }

  for (int i = 0; i < 70; i++) {
    for (int j = 0; j < 18; j++) {
      if (midbar_icon[i][j] == true)
        oled.drawPixel(i, j + 9, 0xD71C);
    }
  }

}
unsigned long previousMillis = 0;

bool sw = false;

void loop() {

  unsigned long currentMillis = millis();

  if (currentMillis - previousMillis >= 2000 && sw == false) {
    previousMillis = currentMillis;
    oled.setTextColor(0x0000);
    oled.setCursor(71, 108);
    oled.print("Press any");
    oled.setCursor(80, 118);
    oled.print("button");
    sw = true;
  }

  if (currentMillis - previousMillis >= 500 && sw == true) {
    previousMillis = currentMillis;
    oled.setTextColor(0xD71C);
    oled.setCursor(71, 108);
    oled.print("Press any");
    oled.setCursor(80, 118);
    oled.print("button");
    sw = false;
  }
}
